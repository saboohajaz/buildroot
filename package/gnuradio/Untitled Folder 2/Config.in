## package/gnuradio/Untitled Folder 2/Config.in
```kconfig
comment "gnuradio needs a toolchain w/ C++, NPTL, wchar, dynamic library"
	depends on BR2_USE_MMU
	depends on !BR2_INSTALL_LIBSTDCPP || !BR2_USE_WCHAR || \
		!BR2_TOOLCHAIN_HAS_THREADS_NPTL || BR2_STATIC_LIBS

config BR2_PACKAGE_GNURADIO
	bool "gnuradio"
	depends on BR2_INSTALL_LIBSTDCPP
	depends on !BR2_STATIC_LIBS
	depends on BR2_TOOLCHAIN_HAS_THREADS_NPTL
	depends on BR2_USE_MMU # use fork()
	depends on BR2_USE_WCHAR # boost
	select BR2_PACKAGE_BOOST
	select BR2_PACKAGE_BOOST_DATE_TIME
	select BR2_PACKAGE_BOOST_FILESYSTEM
	select BR2_PACKAGE_BOOST_PROGRAM_OPTIONS
	select BR2_PACKAGE_BOOST_REGEX
	select BR2_PACKAGE_BOOST_SYSTEM
	select BR2_PACKAGE_BOOST_THREAD

	#select BR2_PACKAGE_ALSA_LIB if !BR2_PACKAGE_PORTAUDIO
	select BR2_PACKAGE_PORTAUDIO
	select BR2_PACKAGE_ALSA_LIB
	select BR2_PACKAGE_GNURADIO_BLOCKS
	select BR2_PACKAGE_GSL
	select BR2_PACKAGE_PYTHON
	select BR2_PACKAGE_PYTHON_NUMPY_ARCH_SUPPORTS
	select BR2_PACKAGE_BOOST_PYTHON
	select BR2_PACKAGE_PYTHON_NUMPY # runtime
	select BR2_PACKAGE_GNURADIO_PYTHON

#comment "gr-fft, -filter, -analog, -channels, -digital, -trellis, -pager, -qtgui depends fftw's single precision"
#	depends on !BR2_PACKAGE_FFTW_PRECISION_SINGLE

	select BR2_PACKAGE_FFTW_PRECISION_SINGLE

	select BR2_PACKAGE_GNURADIO_FILTER

	select BR2_PACKAGE_GNURADIO_ANALOG

	select BR2_PACKAGE_GNURADIO_ANALOG

	select BR2_PACKAGE_GNURADIO_BLOCKS

	select BR2_PACKAGE_GNURADIO_FFT

	select BR2_PACKAGE_GNURADIO_ANALOG

	#depends on BR2_PACKAGE_PYTHON_PYQT
	#depends on BR2_PACKAGE_QWT
	#depends on BR2_PACKAGE_QT_STL
	select BR2_PACKAGE_GNURADIO_FFT
	select BR2_PACKAGE_GNURADIO_FILTER
	select BR2_PACKAGE_GNURADIO_DIGITAL



	select BR2_PACKAGE_FFTW



	help
	  GNU Radio is a free & open-source software development
	  toolkit that provides signal processing blocks to implement
	  software radios. It can be used with readily-available
	  low-cost external RF hardware to create software-defined
	  radios, or without hardware in a simulation-like
	  environment. It is widely used in hobbyist, academic and
	  commercial environments to support both wireless
	  communications research and real-world radio systems.

	  http://gnuradio.org/
```

## package/uhd/Config.in
```kconfig
config BR2_PACKAGE_UHD
	bool "uhd"
depends on BR2_INSTALL_LIBSTDCPP
	depends on !BR2_STATIC_LIBS
	depends on BR2_TOOLCHAIN_HAS_THREADS_NPTL
	depends on BR2_USE_MMU # use fork()
	depends on BR2_USE_WCHAR # boost
	select BR2_PACKAGE_BOOST
	select BR2_PACKAGE_BOOST_DATE_TIME
	select BR2_PACKAGE_BOOST_FILESYSTEM
	select BR2_PACKAGE_BOOST_PROGRAM_OPTIONS
	select BR2_PACKAGE_BOOST_REGEX
	select BR2_PACKAGE_BOOST_SYSTEM
	select BR2_PACKAGE_BOOST_THREAD

	select HOST_PYTHON_MAKO
	select HOST_PKGCONF
	#select HOST_PYTHON_REQUESTS
			   	
	help
	  UHD
	  http://gnuradio.org/
		xselect HOST_PYTHON_REQUESTS
		xselect HOST_PYTHON_REQUESTS_TOOLBELT
```
